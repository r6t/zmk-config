## boards/lpgalaxy/blank_slate/Kconfig.blank_slate
```kconfig
# Copyright (c) 2020 The ZMK Contributors
# SPDX-License-Identifier: MIT

config BOARD_BLANK_SLATE
	select ZMK_BOARD_COMPAT if BOARD_BLANK_SLATE_NRF52840_ZMK
```

## boards/lpgalaxy/blank_slate/Kconfig.defconfig
```kconfig
# Copyright (c) 2020 The ZMK Contributors
# SPDX-License-Identifier: MIT

if BOARD_BLANK_SLATE

config ZMK_BOARD_COMPAT
	default y

endif # BOARD_BLANK_SLATE
```

## boards/lpgalaxy/blank_slate/board.yml
```yaml
board:
  extend: blank_slate
  variants:
    - name: zmk
      qualifier: nrf52840
```

## boards/shields/helix_4row/Kconfig.shield
```kconfig
# Copyright (c) 2020 The ZMK Contributors
# SPDX-License-Identifier: MIT

config SHIELD_HELIX_4ROW_LEFT
    def_bool $(shields_list_contains,helix_4row_left)

config SHIELD_HELIX_4ROW_RIGHT
    def_bool $(shields_list_contains,helix_4row_right)
```
